## drivers/it8951/Kconfig
```kconfig
config EPD_IT8951
	bool "ITE IT8951 Driver"
	default y
	depends on DT_HAS_ITE_IT8951_ENABLED
	depends on SPI && EVENTS && CPP && STD_CPP20 && REQUIRES_FULL_LIBCPP
	help
	  Enable IT8951 driver for electronic paper displays

if EPD_IT8951

    config EPD_IT8951_INIT_PRIORITY
        int
        default 80
        help
          Device driver initialization priority.
          Device is connected to SPI bus, it has to
          be initialized after SPI driver.

    config EPD_READY_LINE_TIMEOUT
        int "Ready line timeout (in milliseconds)"
        default 10000
        help
          A host is required to wait for the RDY line between reads and writes.
          This timeout controls how long (in milliseconds are we allowed to wait).

    config EPD_DISPLAY_READY_TIMEOUT
        int "Display ready timeout (in milliseconds)"
        default 10000

    config EPD_BURST_WRITE_BUFFER_SIZE
        int "Burst-write buffer size in bytes"
        default 200
        help
          Writing pixels may take a long time if the write operations are not optimized.
          Pick this value carefully: if it is too big the IT8951 might stop working (because we only check the
          ready pin once before writing).

    module = IT8951
    module-dep = LOG
    module-str = IT8951
    source "subsys/logging/Kconfig.template.log_config"

endif
```

## dts/bindings/ite,it8951.yaml
```yaml
description: |
  IT8951 EPD (Electronic Paper Display) Timing Controller driver.

compatible: "ite,it8951"

include: spi-device.yaml

properties:
  ready-gpios:
    type: phandle-array
    required: true
    description: |
      Used by the IT8951 to signal to the host when it is ready (low when busy)

  reset-gpios:
    type: phandle-array
    description: |
      Can be used by the host to rest the IT8951 (active low)

  cs-gpios:
    type: phandle-array
    description: |
      Custom CS control (we need to keep the line down for the whole transaction, not just a single buffer)

  vcom:
    type: int
    default: 2500
    description: |
        The VCOM voltages of every e-Paper panel are different and they are printed on FPC cable. Please make sure that
        you use the correct VCOM, otherwise, the display will become worse if the E-paper works under the wrong VCOM
        value for a long time.
        The default is -2.5V. For example, -1.53V should be set as 1530.
```

## modules/expected/Kconfig
```kconfig
config TL_EXPECTED
	bool "tl/expected backport"
	default y
	depends on CPP && REQUIRES_FULL_LIBCPP
	help
	  Enable tl/expected backport
```

## modules/zephyr-cpp/Kconfig
```kconfig
config ZEPHYR_CPP
	bool "Zephyr C++ wrappers"
	default y
	depends on CPP && REQUIRES_FULL_LIBCPP
	help
	  Enable Zephyr C++ wrappers

if ZEPHYR_CPP

    module = ZEPHYR_CPP
    module-dep = LOG
    module-str = zephyr-cpp
    source "subsys/logging/Kconfig.template.log_config"

endif
```

## west.yml
```yaml
manifest:
  remotes:
    - name: zephyrproject-rtos
      url-base: https://github.com/zephyrproject-rtos

  projects:
    - name: zephyr
      remote: zephyrproject-rtos
      # 3.7.0 Broke C++ initialization:
      # - https://github.com/zephyrproject-rtos/zephyr/pull/75915
      revision: v3.7-branch
      import: true

    - name: lz4
      remote: zephyrproject-rtos
      revision: 11b8a1e22fa651b524494e55d22b69d3d9cebcfd
      path: modules/lib/lz4
```
