## CMakeLists.txt
```
cmake_minimum_required(VERSION 3.13.1)
find_package(Zephyr REQUIRED HINTS $ENV{ZEPHYR_BASE})

project(app LANGUAGES C CXX VERSION 1.0.0)

target_include_directories(app PRIVATE include)

target_sources(app PRIVATE
    src/http/server.cpp

    # Broken Zephyr APIs
    src/http/image_server_config.c
    src/http/json.c
    src/http/network_list.c
    src/http/response.c
    src/http/status.c
    src/http/wifi_config.c
    src/fuel_gauge.c

    src/display.cpp
    src/dns.cpp
    src/led.cpp
    src/main.cpp
    src/image_client.cpp
    src/settings.cpp
    src/shell.c
    src/shutdown.cpp
    src/wifi.cpp
)

# HTML Resources
set(HEI_GENERATED_DIR ${CMAKE_CURRENT_BINARY_DIR}/generated/)
set(HEI_GENERATED_INCLUDE_DIR ${HEI_GENERATED_DIR}/hei/)

# Bundle resources
set(HEI_RES_FILES
    index.html
    bootstrap.bundle.min.js
    bootstrap.min.css
)
foreach(res_file ${HEI_RES_FILES})
    generate_inc_file_for_target(app
        res/static/${res_file}
        ${HEI_GENERATED_INCLUDE_DIR}/http/static/${res_file}.gz.inc --gzip)
endforeach()

target_include_directories(app PRIVATE ${HEI_GENERATED_DIR})

# HTTP Server boilerplate
# target_link_libraries(app PRIVATE zephyr_interface zephyr)

zephyr_linker_sources(SECTIONS ld/http-server-sections.ld)
zephyr_linker_section(NAME http_resource_desc_http_server_service
    KVMA RAM_REGION GROUP RODATA_REGION SUBALIGN Z_LINK_ITERABLE_SUBALIGN)

# Add sunflower RAM and ROM reports
foreach(report ram rom)
    add_custom_target(
        ${report}_sunflower
        ${PYTHON_EXECUTABLE}
        ${CMAKE_CURRENT_SOURCE_DIR}/../scripts/footprint
        -b ${CMAKE_CURRENT_BINARY_DIR}
        -t ${report}
        --skip-build
        --html ${report}.html
        DEPENDS ${report}_report
        USES_TERMINAL
        WORKING_DIRECTORY ${CMAKE_CURRENT_BINARY_DIR}
    )
endforeach()
```

## Kconfig
```
menu "Zephyr"
    source "Kconfig.zephyr"
endmenu

config APP_WIFI_CONNECTION_TIMEOUT
    int "Wi-Fi connection timeout in seconds"
    default 30

config APP_WIFI_CONNECTION_ATTEMPTS
    int "Number of Wi-Fi connection attempts"
    default 3

config APP_WIFI_AP_SSID
    string "Default Wi-Fi access point SSID"
    default "HeiAP"

config APP_WIFI_AP_PASSWORD
    string "Default Wi-Fi Access Point password"
    default "HeiPassword"

config APP_DNS_SERVER
    bool "DNS server support"
    default n

config APP_DNS_SERVER_STACK_SIZE
    int "Stack size of the dummy DNS server thread"
    default 1024

config APP_DNS_SERVER_THREAD_PRIORITY
    int "Thread priority of the dummy DNS server thread"
    default 7

config APP_NETWORK_SCAN_INTERVAL
    int "Periodic network scan interval in seconds"
    default 30

config APP_NETWORK_SCAN_DURATION
    int "Periodic network scan duration in seconds"
    default 5

config APP_NETWORK_SCAN_MAX_RESULTS
    int "Maximal number of networks to return during a scan"
    default 10

config APP_IMAGE_CLIENT_THREAD_STACK_SIZE
    int "Image client thread stack size"
    default 4096

config APP_IMAGE_CLIENT_THREAD_PRIORITY
    int "Image client thread priority"
    default 0

config APP_IMAGE_CLIENT_READ_TIMEOUT_SEC
    int "Image client read timeout in seconds"
    default 15

config APP_IMAGE_CLIENT_RECV_BUFFER_SIZE
    int "Image client receive buffer size"
    default 4104

config APP_IMAGE_CLIENT_IMAGE_BUFFER_SIZE
    int "Image client image buffer size"
    default 4096

config APP_IMAGE_CLIENT_DEFAULT_SLEEP_DURATION_SECONDS
    int "Image client default sleep duration"
    help
        Default sleep duration between image fetching cycles (in seconds)
    default 10

config APP_IMAGE_CLIENT_NUM_SHUTDOWN_REQUESTS
    int "Number of image client shutdown requests"
    help
        Repeat a shutdown request this many times, just in case the power board misses one
    default 10

config APP_IMAGE_CLIENT_SHUTDOWN_REQUEST_DELAY_MS
    int "Delay between image client shutdown requests (in milliseconds)"
    default 100

module = APP
module-str = APP
source "subsys/logging/Kconfig.template.log_config"
```

## prj.conf
```kconfig
# Stack sizes
CONFIG_MAIN_STACK_SIZE=4096
CONFIG_NET_CONNECTION_MANAGER_MONITOR_STACK_SIZE=4096
CONFIG_SYSTEM_WORKQUEUE_STACK_SIZE=4096
CONFIG_NET_SOCKETS_SERVICE_STACK_SIZE=4096
CONFIG_NET_TX_STACK_SIZE=4096
CONFIG_NET_RX_STACK_SIZE=4096
CONFIG_HTTP_SERVER_STACK_SIZE=4096
CONFIG_STACK_CANARIES=y
CONFIG_STACK_SENTINEL=y

# HTTP-Specific
CONFIG_ZVFS_OPEN_MAX=16
CONFIG_POSIX_API=y
CONFIG_FDTABLE=y
CONFIG_NET_SOCKETS_POLL_MAX=16

# IP address options
CONFIG_NET_MAX_CONTEXTS=16
CONFIG_NET_MAX_CONN=16

# Network buffers
CONFIG_NET_PKT_RX_COUNT=24
CONFIG_NET_PKT_TX_COUNT=24
CONFIG_NET_BUF_RX_COUNT=24
CONFIG_NET_BUF_TX_COUNT=24

# Hostname configuration
CONFIG_NET_HOSTNAME_ENABLE=y
CONFIG_NET_HOSTNAME="hei.local"

# C++ support
CONFIG_CPP=y
CONFIG_STD_CPP20=y
CONFIG_REQUIRES_FULL_LIBCPP=y

# Additional kernel features
CONFIG_EVENTS=y
CONFIG_INIT_STACKS=y

# Eventfd
CONFIG_EVENTFD=y
CONFIG_ZVFS_EVENTFD_MAX=2

# Networking
CONFIG_WIFI=y
CONFIG_WIFI_ESP32=y
CONFIG_NETWORKING=y
CONFIG_NET_L2_ETHERNET=y
CONFIG_ETH_DRIVER=n
CONFIG_NET_IPV4=y
CONFIG_NET_IPV6=n
CONFIG_NET_TCP=y
CONFIG_NET_IPV4_ACD=y
CONFIG_NET_ARP=y
CONFIG_NET_UDP=y

CONFIG_ESP32_WIFI_IRAM_OPT=y
CONFIG_ESP32_WIFI_RX_IRAM_OPT=y

CONFIG_NET_SOCKETS=y

CONFIG_NET_CONNECTION_MANAGER=y

CONFIG_NET_DHCPV4=y
CONFIG_NET_DHCPV4_SERVER=y

# HTTP parser
CONFIG_HTTP_PARSER_URL=y
CONFIG_HTTP_PARSER=y
CONFIG_HTTP_SERVER=y

# Additional libraries
CONFIG_JSON_LIBRARY=y

# Non-volatile settings storage
CONFIG_FLASH=y
CONFIG_FLASH_PAGE_LAYOUT=y
CONFIG_FLASH_MAP=y
CONFIG_NVS=y
CONFIG_SETTINGS=y
CONFIG_SETTINGS_NVS=y
CONFIG_MPU_ALLOW_FLASH_WRITE=y

# Additional drivers
CONFIG_FUEL_GAUGE=y
CONFIG_SPI=y
CONFIG_SPI_ESP32_INTERRUPT=y

CONFIG_REBOOT=y

# Image decompression
CONFIG_LZ4=y
CONFIG_REQUIRES_FULL_LIBC=y
```

## src/main.cpp
```c
#include <autoconf.h>

#include <zephyr/devicetree.h>
#include <zephyr/drivers/gpio.h>
#include <zephyr/kernel.h>
#include <zephyr/logging/log.h>
#include <zephyr/sys/reboot.h>

#include <hei/fuel_gauge.h>
#include <hei/display.hpp>
#include <hei/http/server.hpp>
#include <hei/image_client.hpp>
#include <hei/led.hpp>
#include <hei/wifi.hpp>

LOG_MODULE_REGISTER(main, CONFIG_APP_LOG_LEVEL);

[[noreturn]] void fatal_error(const char *msg) {
   LOG_ERR("Fatal error: %s", msg);

   bool state = true;
   for (int i = 0; i < 15; ++i) {
      (void)hei::led::set_state(state);
      state = !state;

      k_sleep(K_MSEC(200));
   }

   sys_reboot(SYS_REBOOT_COLD);
}

void setup_connectivity() {
   auto res = hei::wifi::setup();
   if (!res) {
      // Neither connection nor AP could work: we can't to anything: go into error mode
      LOG_ERR("Wi-Fi setup error: %s", res.error().message().c_str());
      fatal_error("Wi-Fi configuration failed");
   }
}

int main() {
   if (!hei::display::init()) {
      fatal_error("Display initialization failed");
   }

   setup_connectivity();

   hei::http::server::start();
   if (!hei::wifi::is_hosting()) {
      hei::image_client::start();
   }
}
```

## src/display.cpp
```c
/**
 * @file   display.cpp
 * @author Dennis Sitelew
 * @date   Oct. 03, 2024
 */

#include <hei/display.hpp>

#include <it8951/display.hpp>

#include <zephyr/logging/log.h>

#include <optional>
#include <stdexcept>

LOG_MODULE_REGISTER(display, CONFIG_APP_LOG_LEVEL);

#if CONFIG_SHELL
#include <zephyr/shell/shell.h>
#endif

namespace {

const struct device *const display_driver = DEVICE_DT_GET_ONE(ite_it8951);
it8951::display display{*display_driver};

} // namespace

namespace hei::display {

bool init() {
   if (!device_is_ready(display_driver)) {
      LOG_ERR("Display not ready: %s", display_driver->name);
      return false;
   }

   return true;
}

it8951::display &get() {
   return ::display;
}

} // namespace hei::display

#if CONFIG_SHELL

namespace {

template <typename T>
bool shell_parse(const shell *sh, const char *arg, const char *name, int base, T &out) {
   auto handle_err = [&](int err, auto value) {
      if (err == -EINVAL) {
         shell_error(sh, "Bad %s string: %s", name, arg);
         return false;
      } else if (err == -ERANGE) {
         shell_error(sh, "%s value out of range: %s", name, arg);
         return false;
      }

      out = static_cast<T>(value);
      return true;
   };

   int err;
   if constexpr (std::is_signed_v<T>) {
      static_assert(sizeof(T) <= sizeof(long));
      auto res = shell_strtol(arg, base, &err);
      return handle_err(err, res);
   } else {
      static_assert(sizeof(T) <= sizeof(unsigned long long));
      auto res = shell_strtoull(arg, base, &err);
      return handle_err(err, res);
   }
}

template <typename T>
std::optional<T> shell_parse(const shell *sh, const char *arg, const char *name, int base) {
   T res;
   if (!shell_parse(sh, arg, name, base, res)) {
      return {};
   }

   return res;
}

int shell_do_fill(const shell *sh, size_t argc, const char **argv) {
   ARG_UNUSED(argc);

   auto opt_pattern = shell_parse<std::uint64_t>(sh, argv[1], "pattern", 16);
   auto opt_mode = shell_parse<std::uint8_t>(sh, argv[2], "mode", 10);

   if (!opt_pattern || !opt_mode) {
      return -EINVAL;
   }

   auto mode = static_cast<it8951::common::waveform_mode>(*opt_mode);
   switch (mode) {
      case it8951::common::waveform_mode::init:
      case it8951::common::waveform_mode::direct_update:
      case it8951::common::waveform_mode::grayscale_clearing:
      case it8951::common::waveform_mode::grayscale_limited:
      case it8951::common::waveform_mode::grayscale_limited_reduced:
         break;
      default:
         shell_error(sh, "Invalid mode: %d", (int)mode);
         return -EINVAL;
   }

   const auto pattern = *opt_pattern;

   // We expect 4bpp encoding, so we have to split the uint64_t into 16 bytes
   std::array<std::uint8_t, 16> as_bytes{};
   for (int i = 7; i >= 0; --i) {
      std::uint8_t byte;
      if (i != 0) {
         byte = static_cast<std::uint8_t>((pattern >> (8 * i)) & 0xFF);
      } else {
         byte = static_cast<std::uint8_t>(pattern & 0xFF);
      }

      const uint8_t high = (byte >> 4) & 0xF;
      const uint8_t low = byte & 0xF;

      const auto idx = (7 - i) * 2;
      as_bytes[idx] = high;
      as_bytes[idx + 1] = low;
   }
   LOG_HEXDUMP_INF(as_bytes.data(), as_bytes.size(), "Pattern");

   auto width = display.width();

   auto fr = ::display.fill_screen(
      [&](auto x, auto y) -> std::uint8_t {
         const auto idx = ((width * y) + x);
         return as_bytes[idx % as_bytes.size()];
      },
      mode);

   if (!fr) {
      shell_error(sh, "Error filling the screen: %s", fr.error().message().c_str());
      return -EINVAL;
   }

   return 0;
}

int shell_do_clear(const shell *sh, size_t argc, const char **argv) {
   ARG_UNUSED(sh);
   ARG_UNUSED(argc);
   ARG_UNUSED(argv);

   auto cr = ::display.clear();
   if (!cr) {
      shell_error(sh, "Error cleaning screen: %s", cr.error().message().data());
      return -1;
   }

   return 0;
}

int dummy_help(const shell *sh, size_t argc, const char **argv) {
   if (argc == 1) {
      shell_help(sh);
      return 1;
   }

   static_assert(sizeof(unsigned long long) >= sizeof(std::uint64_t));

   shell_error(sh, "%s unknown command: %s", argv[0], argv[1]);
   return -EINVAL;
}

} // namespace

SHELL_STATIC_SUBCMD_SET_CREATE(display_commands,
                               SHELL_CMD_ARG(fill,
                                             NULL,
                                             R"help(Fill the screen with a multi-byte pattern.
Usage: fill <pattern> <mode>
- <pattern> B0B1B2B3B4B5B6B7B8 in hex, where B0 will be passed for pixels [0, 0] and [1, 0] etc., e.g. 123456789ABCDEF
- <mode> Waveform mode: 0 - init, 1 - DU, 2 - GC16, 3 - GL16, 4 - GLR16)help",
                                             shell_do_fill,
                                             3,
                                             0),
                               SHELL_CMD_ARG(clear, NULL, "Clear the screen", shell_do_clear, 1, 0),
                               SHELL_SUBCMD_SET_END);

SHELL_SUBCMD_ADD((hei), display, &display_commands, "Display shell", dummy_help, 2, 0);

#endif // CONFIG_SHELL
```

## src/dns.cpp
```c
/**
 * @file   dns.cpp
 * @author Dennis Sitelew
 * @date   Aug. 12, 2024
 */

#include <hei/dns.hpp>

#include <autoconf.h>

#include <zephyr/logging/log.h>

LOG_MODULE_REGISTER(hei_dns, CONFIG_APP_LOG_LEVEL);

#if CONFIG_APP_DNS_SERVER
#include <zephyr/kernel.h>
#include <zephyr/net/net_config.h>
#include <zephyr/net/net_ip.h>
#include <zephyr/net/socket.h>

#include <cstdint>

namespace {

namespace dns {

// DNS server events
enum event : std::uint32_t {
   start = BIT(0),
   running = BIT(1),
   error = BIT(12),
};

K_EVENT_DEFINE(status)

atomic_t last_error = ATOMIC_INIT(0);

constexpr std::uint16_t port = 53;
constexpr int max_message_len = 512;

struct header {
   std::uint16_t id;
   std::uint16_t flags;
   std::uint16_t qdcount;
   std::uint16_t ancount;
   std::uint16_t nscount;
   std::uint16_t arcount;
};

struct question {
   std::uint16_t qtype;
   std::uint16_t qclass;
};

struct resource {
   std::uint16_t type;
   std::uint16_t rdata_class;
   std::uint32_t ttl;
   std::uint16_t rdlength;
};

} // namespace dns

void dns_server_thread(void *p1, void *p2, void *p3) {
   ARG_UNUSED(p1);
   ARG_UNUSED(p2);
   ARG_UNUSED(p3);

   k_event_wait(&dns::status, dns::event::start, false, K_FOREVER);
   LOG_DBG("Starting DNS server");

   int sock = socket(AF_INET, SOCK_DGRAM, IPPROTO_UDP);
   if (sock < 0) {
      LOG_ERR("Failed to create socket: %d", sock);
      atomic_set(&dns::last_error, sock);
      k_event_set(&::dns::status, ::dns::event::error);
      return;
   }

   LOG_DBG("Socket created");
   const sockaddr_in server_addr = {.sin_family = AF_INET,
                                    .sin_port = htons(dns::port),
                                    .sin_addr = {.s_addr = INADDR_ANY}};

   if (auto err = bind(sock, reinterpret_cast<const sockaddr *>(&server_addr), sizeof(server_addr)) < 0) {
      LOG_ERR("Failed to bind to port %" PRIu16 ": %d", dns::port, err);
      atomic_set(&dns::last_error, err);
      close(sock);
      k_event_set(&::dns::status, ::dns::event::error);
      return;
   }

   LOG_DBG("Socket bound");
   auto iface = net_if_get_default();
   if (!iface) {
      LOG_ERR("Could not find default interface");
      atomic_set(&dns::last_error, -ENETDOWN);
      close(sock);
      k_event_set(&::dns::status, ::dns::event::error);
      return;
   }

   const auto server_ip = iface->config.ip.ipv4->unicast[0].ipv4.address.in_addr.s4_addr;

   k_event_set(&::dns::status, ::dns::event::running);

   static std::uint8_t rx_buf[dns::max_message_len];
   static std::uint8_t tx_buf[dns::max_message_len];

   sockaddr_in client_addr{};
   socklen_t client_addr_len = sizeof(client_addr);
   while (true) {
      LOG_DBG("Waiting for a request");
      int received =
         recvfrom(sock, rx_buf, sizeof(rx_buf), 0, reinterpret_cast<sockaddr *>(&client_addr), &client_addr_len);
      if (received < 0) {
         LOG_WRN("Failed to receive: %d", received);
         continue;
      }

      if (received < static_cast<int>(sizeof(dns::header))) {
         LOG_WRN("DNS message too short: %d", received);
         continue;
      }

      LOG_DBG("Received %d bytes", received);

      // Copy the received message to the transmit buffer
      memcpy(tx_buf, rx_buf, received);

      auto header = reinterpret_cast<dns::header *>(tx_buf);
      header->flags = htons(0x8180); // Standard query response, No error
      header->ancount = htons(1);    // One answer

      // Skip the question section
      std::uint8_t *answer_ptr = tx_buf + received;

      // Construct the answer section
      *answer_ptr++ = 0xc0; // Pointer to domain name
      *answer_ptr++ = 0x0c; // Offset to domain name (12 bytes from start)

      auto resource = reinterpret_cast<dns::resource *>(answer_ptr);
      resource->type = htons(1);        // A record
      resource->rdata_class = htons(1); // IN class
      resource->ttl = htonl(300);       // 5 minutes TTL
      resource->rdlength = htons(4);    // 4 bytes for IPv4 address
      answer_ptr += sizeof(dns::resource);

      LOG_INF("%d %d %d %d", server_ip[0], server_ip[1], server_ip[2], server_ip[3]);
      *answer_ptr++ = server_ip[0];
      *answer_ptr++ = server_ip[1];
      *answer_ptr++ = server_ip[2];
      *answer_ptr++ = server_ip[3];

      int response_len = answer_ptr - tx_buf;

      LOG_DBG("Sending response");
      sendto(sock, tx_buf, response_len, 0, reinterpret_cast<sockaddr *>(&client_addr), client_addr_len);
   }
}

K_THREAD_DEFINE(dns_server_id,
                CONFIG_APP_DNS_SERVER_STACK_SIZE,
                dns_server_thread,
                NULL,
                NULL,
                NULL,
                CONFIG_APP_DNS_SERVER_THREAD_PRIORITY,
                0,
                0);

} // namespace

#endif

namespace hei::dns::server {

void_t start() {
#if CONFIG_APP_DNS_SERVER
   k_event_set(&::dns::status, ::dns::event::start);

   auto events = k_event_wait(&::dns::status, ::dns::event::running | ::dns::event::error, false, K_FOREVER);
   if ((events & ::dns::event::running) != ::dns::event::running) {
      LOG_ERR("Error starting DNS server");
      return zephyr::unexpected((int)atomic_get(&::dns::last_error));
   }

   LOG_INF("DNS server started");
#else
   // Probably because the DHCPv4 server doesn't allow us to set a DNS server, so no captive portal for us :'(
   LOG_ERR("DNS server unsupported");
#endif
   return {};
}

} // namespace hei::dns::server
```

## src/fuel_gauge.c
```c
/**
 * @file   fuel_gauge.c
 * @author Dennis Sitelew
 * @date   Jul. 24, 2024
 */

#include <hei/fuel_gauge.h>

#include <zephyr/devicetree.h>
#include <zephyr/drivers/fuel_gauge.h>
#include <zephyr/logging/log.h>

static const struct device *const fuel_gauge = DEVICE_DT_GET_ONE(maxim_max17048);

LOG_MODULE_REGISTER(fuel_gauge, CONFIG_APP_LOG_LEVEL);

bool hei_fuel_gauge_init(void) {
   if (!device_is_ready(fuel_gauge)) {
      LOG_ERR("Fuel gauge not ready: %s", fuel_gauge->name);
      return false;
   }

   return true;
}

void hei_fuel_gauge_print(void) {
   const hei_fuel_gauge_measurement_t mes = hei_fuel_gauge_get();
   if (mes.valid) {
      return;
   }

   LOG_INF("Time to empty %" PRIu32, mes.runtime_to_empty_minutes);
   LOG_INF("Time to full %" PRIu32, mes.runtime_to_full_minutes);
   LOG_INF("Charge  %" PRIu8 "%%", mes.relative_state_of_charge_percentage);
   LOG_INF("Voltage %d", mes.voltage_uv);
}

hei_fuel_gauge_measurement_t hei_fuel_gauge_get(void) {
   if (!device_is_ready(fuel_gauge)) {
      LOG_WRN("Fuel gauge not ready: %s", fuel_gauge->name);
      return (hei_fuel_gauge_measurement_t){.valid = false};
   }

   // This is everything, MAX17048 supports (at least it's driver doesn't support anything else at the moment).
   fuel_gauge_prop_t props[] = {
      FUEL_GAUGE_RUNTIME_TO_EMPTY,
      FUEL_GAUGE_RUNTIME_TO_FULL,
      FUEL_GAUGE_RELATIVE_STATE_OF_CHARGE,
      FUEL_GAUGE_VOLTAGE,
   };

   union fuel_gauge_prop_val vals[ARRAY_SIZE(props)];

   int err = fuel_gauge_get_props(fuel_gauge, props, vals, ARRAY_SIZE(props));
   if (err < 0) {
      LOG_ERR("Fuel gauge read failed");
      return (hei_fuel_gauge_measurement_t){.valid = false};
   }

   const int voltage = vals[3].voltage;
   if (voltage < 0) {
      LOG_ERR("Unexpected negative voltage: %d", voltage);
      return (hei_fuel_gauge_measurement_t){.valid = false};
   }

   return (hei_fuel_gauge_measurement_t){
      .valid = true,
      .runtime_to_empty_minutes = vals[0].runtime_to_empty,
      .runtime_to_full_minutes = vals[1].runtime_to_full,
      .relative_state_of_charge_percentage = vals[2].relative_state_of_charge,
      .voltage_uv = (uint32_t)voltage,
   };
}
```

## src/image_client.cpp
```c
/**
 * @file   image_client.cpp
 * @author Dennis Sitelew
 * @date   Sep. 30, 2024
 */

#include <hei/fuel_gauge.h>
#include <hei/common.hpp>
#include <hei/display.hpp>
#include <hei/image_client.hpp>
#include <hei/settings.hpp>
#include <hei/shutdown.hpp>

#include <zephyr-cpp/error.hpp>

#include <zephyr/kernel.h>
#include <zephyr/logging/log.h>

#include <arpa/inet.h>
#include <fcntl.h>
#include <sys/select.h>
#include <sys/socket.h>
#include <cerrno>

#include <lz4.h>

#include <array>
#include <tuple>
#include <utility>

#include <autoconf.h>

#if CONFIG_SHELL
#include <zephyr/shell/shell.h>
#endif

LOG_MODULE_REGISTER(image_client, CONFIG_APP_LOG_LEVEL);

using namespace zephyr;

namespace {

enum client_event_t {
   ce_start = BIT(0),
   ce_manual_fetch = BIT(1),
   ce_stop = BIT(2),
};

K_EVENT_DEFINE(client_events)

class image_client {
private:
   enum class message_type : std::uint8_t {
      get_image_request = 0x10,
      image_header_response = 0x11,
      image_block_response = 0x12,
      server_error = 0x50,
   };

   struct get_image_request {
   public:
      // type: u8, fg_valid: u8, runtime_to_empty: u32, runtime_to_full: u32, charge_percentage: u8, voltage: u32
      static constexpr std::size_t array_size = 1 + 1 + 4 + 4 + 1 + 4;
      using array_t = std::array<std::uint8_t, array_size>;

   public:
      get_image_request() {
         auto it = payload.begin();
         write(it, static_cast<std::uint8_t>(message_type::get_image_request));

         // ReSharper disable once CppUseStructuredBinding
         const auto fg = hei_fuel_gauge_get();
         write(it, static_cast<std::uint8_t>(fg.valid));
         if (!fg.valid) {
            // We don't care about rest of the fields if the fuel gauge is not available
            return;
         }

         write(it, fg.runtime_to_empty_minutes);
         write(it, fg.runtime_to_full_minutes);
         write(it, fg.relative_state_of_charge_percentage);
         write(it, fg.voltage_uv);
      }

   private:
      template <std::unsigned_integral T>
      static void write(array_t::iterator &it, const T value) {
         constexpr auto size = sizeof(T);
         if (size == 1) {
            // Only one byte - just write it
            *it = static_cast<std::uint8_t>(value);
            std::advance(it, 1U);
            return;
         }

         // Encode as little-endian
         for (std::size_t i = 0; i < size; ++i) {
            if (i == 0) {
               *it = static_cast<std::uint8_t>(value & 0xFF);
            } else {
               *it = static_cast<std::uint8_t>((value >> (i * 8)) & 0xFF);
            }

            std::advance(it, 1U);
         }
      }

   public:
      array_t payload{};
   };

public:
   static void thread_fn(void *p1, void *p2, void *p3) {
      ARG_UNUSED(p2);
      ARG_UNUSED(p3);

      const auto client = static_cast<image_client *>(p1);
      client->main();
   }

private:
   static void request_shutdown(const std::chrono::seconds sleep_duration) {
      for (int i = 0; i < CONFIG_APP_IMAGE_CLIENT_NUM_SHUTDOWN_REQUESTS; ++i) {
         hei::shutdown::request(sleep_duration);
         k_sleep(K_MSEC(CONFIG_APP_IMAGE_CLIENT_SHUTDOWN_REQUEST_DELAY_MS));
      }
   }

   [[noreturn]] void main() {
      (void)k_event_wait(&client_events, ce_start, false, K_FOREVER);

      const auto interval_opt = hei::settings::image_server::refresh_interval();

      std::chrono::seconds sleep_duration{CONFIG_APP_IMAGE_CLIENT_DEFAULT_SLEEP_DURATION_SECONDS};
      if (interval_opt) {
         sleep_duration = *interval_opt;
      }

      while (true) {
         if (!convert_server_address()) {
            request_shutdown(sleep_duration);
            continue;
         }

         const auto start = k_uptime_get();

         auto res = fetch_image();
         if (res) {
            const auto end = k_uptime_get();

            // ReSharper disable once CppDFAUnusedValue CppDFAUnreadVariable CppDeclaratorNeverUsed
            const auto delta = end - start;
            LOG_INF("Received image in %" PRIi64 " ms", delta);
         } else {
            LOG_ERR("Image client error: %s", res.error().message().c_str());
         }

         // In any case try putting the display into the sleep mode to avoid potential issues with the driver board
         res = shutdown_display();
         if (!res) {
            LOG_ERR("Display shutdown error: %s", res.error().message().c_str());
         }

         if (socket_) {
            if (close(socket_)) {
               LOG_ERR("Close error: %s", strerror(errno));
            }

            socket_ = 0;
         }

         // Try shutting down
         for (int i = 0; i < 10; ++i) {
            hei::shutdown::request(sleep_duration);
            k_sleep(K_MSEC(100));
         }

         if (const auto events =
                k_event_wait(&client_events, ce_manual_fetch | ce_stop, true, K_SECONDS(sleep_duration.count()));
             events & ce_stop) {
            k_event_wait(&client_events, ce_start, true, K_FOREVER);
         }
      }

      // ReSharper disable once CppDFAUnreachableCode
   }

   static auto report_error(const char *message, const int error) {
      LOG_ERR("%s: %s", message, strerror(error));
      return unexpected(error);
   }

   void_t fetch_image() {
      namespace common_t = it8951::common;

      if ((socket_ = socket(AF_INET, SOCK_STREAM, 0)) < 0) {
         return report_error("Socket creation error", errno);
      }

      if (connect(socket_, reinterpret_cast<sockaddr *>(&server_address_), sizeof(server_address_)) < 0) {
         return report_error("Connection failed", errno);
      }

      LOG_INF("Connected to server");

      // Set socket to non-blocking mode
      const int flags = fcntl(socket_, F_GETFL, 0);
      if (flags < 0) {
         return report_error("Error getting socket flags", errno);
      }

      if (fcntl(socket_, F_SETFL, flags | O_NONBLOCK) < 0) {
         return report_error("Error setting socket flags", errno);
      }

      // Request the new image (together with the refresh type) and send the fuel gauge readings at the same time
      get_image_request req{};
      if (auto res = send(req.payload); !res) {
         return report_error("Error sending request", res.error().value());
      }

      // Read header: message_type: u8, update_type: u8, width: u16, height: u16, num_blocks: u16
      using response_t = std::tuple<std::uint8_t, std::uint8_t, std::uint16_t, std::uint16_t, std::uint16_t>;
      auto response_res = read_tuple<response_t>();
      if (!response_res) {
         return tl::unexpected{response_res.error()};
      }

      const auto [type_raw, mode_raw, width_raw, image_height, num_blocks] = *response_res;

      auto type = static_cast<message_type>(type_raw);
      if (type == message_type::server_error) {
         LOG_WRN("Server error");
         return unexpected(EBADMSG);
      }

      if (type != message_type::image_header_response) {
         LOG_ERR("Bad response: %" PRIu8, static_cast<std::uint8_t>(type));
         return unexpected(EBADMSG);
      }

      const auto mode = static_cast<common_t::waveform_mode>(mode_raw);
      switch (mode) {
         case it8951::common::waveform_mode::init:
         case it8951::common::waveform_mode::direct_update:
         case it8951::common::waveform_mode::grayscale_clearing:
         case it8951::common::waveform_mode::grayscale_limited:
         case it8951::common::waveform_mode::grayscale_limited_reduced:
            break;

         default:
            LOG_ERR("Bad wave form mode: %d", static_cast<int>(mode));
            return unexpected(EBADMSG);
      }

      // x2 because the transmitted image is 4 bytes per pixel
      const auto image_width = static_cast<std::uint16_t>(width_raw * 2);

      LOG_DBG("Image Header: w=%" PRIu16 ", h=%" PRIu16 ", n=%" PRIu16, image_width, image_height, num_blocks);

      auto &display = hei::display::get();
      auto dr = display.begin({.x = 0, .y = 0, .width = image_width, .height = image_height},
                              {.endianness = common_t::endianness::little,
                               .pixel_format = common_t::pixel_format::pf4bpp,
                               .rotation = common_t::rotation::rotate0,
                               .mode = mode});
      if (!dr) {
         return dr;
      }

      for (std::uint16_t block = 0; block < num_blocks; ++block) {
         using block_t = std::tuple<std::uint8_t, std::uint16_t, std::uint16_t>;
         auto block_res = read_tuple<block_t>();
         if (!block_res) {
            return tl::unexpected{response_res.error()};
         }

         const auto [block_type_raw, uncompressed_size, compressed_size] = *block_res;
         type = static_cast<message_type>(block_type_raw);
         if (type == message_type::server_error) {
            LOG_WRN("Server error");
            return unexpected(EBADMSG);
         }

         if (type != message_type::image_block_response) {
            LOG_ERR("Bad block type: %" PRIu8, static_cast<std::uint8_t>(type));
            return unexpected(EBADMSG);
         }

         if (auto ec = receive(compressed_size); !ec) {
            return report_error("Error receiving block", ec.error().value());
         }

         const auto res = LZ4_decompress_safe(reinterpret_cast<const char *>(recv_buffer_.data()),
                                              reinterpret_cast<char *>(image_buffer_.data()), compressed_size,
                                              static_cast<int>(image_buffer_.size()));
         if (res < 0) {
            LOG_ERR("Image block decompression error: %d", res);
            return unexpected(res);
         }

         if (res != uncompressed_size) {
            LOG_ERR("Decompressed data size mismatch: %d vs %d", res, static_cast<int>(uncompressed_size));
            return unexpected(EBADMSG);
         }

         dr = display.update({image_buffer_.data(), uncompressed_size});
         if (!dr) {
            return dr;
         }
      }

      return display.end();
   }

   static void_t shutdown_display() {
      auto &display = hei::display::get();
      return display.shutdown();
   }

   bool convert_server_address() {
      const auto port_opt = hei::settings::image_server::port();
      if (!port_opt) {
         LOG_ERR("Missing server port");
         return false;
      }

      const auto address_opt = hei::settings::image_server::address();
      if (!address_opt) {
         LOG_ERR("Missing server address");
         return false;
      }

      server_address_.sin_family = AF_INET;
      server_address_.sin_port = htons(*port_opt);

      // TODO: DNS support
      if (inet_pton(AF_INET, address_opt->data(), &server_address_.sin_addr) <= 0) {
         LOG_ERR("Unsupported address: %s", address_opt->data());
         return false;
      }

      return true;
   }

   template <typename Tuple, std::size_t I>
   bool read_tuple_element(Tuple &t, std::error_code &ec) {
      using element_t = std::tuple_element_t<I, Tuple>;
      if (auto res = read<element_t>()) {
         std::get<I>(t) = res.value();
         return true;
      } else {
         ec = res.error();
         return false;
      }
   }

   template <typename Tuple, std::size_t... I>
   void_t read_tuple_impl(Tuple &t, std::index_sequence<I...>) {
      std::error_code ec;
      if (const bool success = (read_tuple_element<Tuple, I>(t, ec) && ...); !success) {
         return tl::unexpected{ec};
      }
      return {};
   }

   template <typename Tuple>
   expected<Tuple> read_tuple() {
      Tuple res;
      const auto op_res = read_tuple_impl(res, std::make_index_sequence<std::tuple_size_v<Tuple>>{});
      if (!op_res) {
         return tl::unexpected{op_res.error()};
      }
      return res;
   }

   template <std::unsigned_integral T>
   expected<T> read() {
      constexpr auto size = sizeof(T);
      if (auto ec = receive(size); !ec) {
         return tl::unexpected(ec.error());
      }

      if (size == 1) {
         // Only one byte - just return it after casting
         return static_cast<T>(recv_buffer_[0]);
      }

      // Decode as little-endian
      T result{};
      for (std::size_t i = 0; i < size; ++i) {
         if (i == 0) {
            result |= recv_buffer_[i];
            continue;
         }

         const T tmp = static_cast<T>(static_cast<T>(recv_buffer_[i]) << (i * 8));
         result |= tmp;
      }

      return result;
   }

   [[nodiscard]] void_t receive(std::size_t num_bytes) {
      fd_set read_fds{}, err_fds{};
      timeval tv{};

      std::size_t offset = 0;
      while (true) {
         if (offset == num_bytes) {
            // Done reading requested number of bytes
            return {};
         }

         FD_ZERO(&read_fds);
         FD_ZERO(&err_fds);
         FD_SET(socket_, &read_fds);
         FD_SET(socket_, &err_fds);

         tv.tv_sec = CONFIG_APP_IMAGE_CLIENT_READ_TIMEOUT_SEC;
         tv.tv_usec = 0;

         const int activity = select(socket_ + 1, &read_fds, nullptr, &err_fds, &tv);
         if (activity < 0) {
            return report_error("Read select error", errno);
         }

         if (activity == 0) {
            LOG_ERR("Receive timeout");
            return unexpected(ETIMEDOUT);
         }

         if (FD_ISSET(socket_, &err_fds)) {
            int error = 0;
            socklen_t len = sizeof(error);
            if (getsockopt(socket_, SOL_SOCKET, SO_ERROR, &error, &len) < 0) {
               LOG_ERR("Unknown read socket error");
               return unexpected(EIO);
            } else if (error != 0) {
               return report_error("Read socket error", error);
            }
            return unexpected(EIO);
         }

         if (!FD_ISSET(socket_, &read_fds)) {
            continue;
         }

         const ssize_t num_received = ::read(socket_, recv_buffer_.data() + offset, num_bytes - offset);
         if (num_received == 0) {
            LOG_ERR("Read connection closed");
            return unexpected(ECONNRESET);
         }

         if (num_received > 0) {
            offset += num_received;
            continue;
         }

         // ReSharper disable once CppIdenticalOperandsInBinaryExpression CppDFAConstantConditions
         if (const int error = errno; error != EWOULDBLOCK && error != EAGAIN) {
            return report_error("Read error", error);
         }
      }
   }

   [[nodiscard]] void_t send(const std::span<const std::uint8_t> payload) const {
      fd_set write_fds{}, err_fds{};
      timeval tv{};

      std::size_t offset = 0;
      while (true) {
         if (offset == payload.size()) {
            // Done writing requested number of bytes
            return {};
         }

         FD_ZERO(&write_fds);
         FD_ZERO(&err_fds);
         FD_SET(socket_, &write_fds);
         FD_SET(socket_, &err_fds);

         tv.tv_sec = CONFIG_APP_IMAGE_CLIENT_READ_TIMEOUT_SEC;
         tv.tv_usec = 0;

         const int activity = select(socket_ + 1, nullptr, &write_fds, &err_fds, &tv);
         if (activity < 0) {
            return report_error("Send select error", errno);
         }

         if (activity == 0) {
            LOG_ERR("Send timeout");
            return unexpected(ETIMEDOUT);
         }

         if (FD_ISSET(socket_, &err_fds)) {
            int error = 0;
            socklen_t len = sizeof(error);
            if (getsockopt(socket_, SOL_SOCKET, SO_ERROR, &error, &len) < 0) {
               LOG_ERR("Unknown send socket error");
               return unexpected(EIO);
            } else if (error != 0) {
               return report_error("Send socket error", error);
            }
            return unexpected(EIO);
         }

         if (!FD_ISSET(socket_, &write_fds)) {
            continue;
         }

         const ssize_t num_sent = ::send(socket_, payload.data() + offset, payload.size() - offset, 0);
         if (num_sent == 0) {
            LOG_ERR("Send connection closed");
            return unexpected(ECONNRESET);
         }

         if (num_sent > 0) {
            offset += num_sent;
            continue;
         }

         // ReSharper disable once CppIdenticalOperandsInBinaryExpression CppDFAConstantConditions
         if (const int error = errno; error != EWOULDBLOCK && error != EAGAIN) {
            return report_error("Send error", error);
         }
      }
   }

private:
   sockaddr_in server_address_{};
   int socket_{};
   std::array<std::uint8_t, CONFIG_APP_IMAGE_CLIENT_RECV_BUFFER_SIZE> recv_buffer_{};
   std::array<std::uint8_t, CONFIG_APP_IMAGE_CLIENT_IMAGE_BUFFER_SIZE> image_buffer_{};
};

image_client client{};

K_THREAD_STACK_DEFINE(image_client_thread_stack, CONFIG_APP_IMAGE_CLIENT_THREAD_STACK_SIZE);

// ReSharper disable CppDeclaratorNeverUsed
// NOLINTBEGIN(*-branch-clone, *-misplaced-const)
K_THREAD_DEFINE(image_client_thread_id,
                CONFIG_APP_IMAGE_CLIENT_THREAD_STACK_SIZE,
                image_client::thread_fn,
                &client,
                nullptr,
                nullptr,
                CONFIG_APP_IMAGE_CLIENT_THREAD_PRIORITY,
                0,
                0);
// NOLINTEND(*-branch-clone, *-misplaced-const)
// ReSharper restore CppDeclaratorNeverUsed

} // namespace

namespace hei::image_client {

void start() {
   k_event_post(&client_events, ce_start);
}

} // namespace hei::image_client

#if CONFIG_SHELL

namespace {

int shell_do_fetch(const shell *sh, size_t argc, const char **argv) {
   ARG_UNUSED(sh);
   ARG_UNUSED(argc);
   ARG_UNUSED(argv);

   k_event_post(&client_events, ce_manual_fetch);
   return 0;
}

int shell_do_stop(const shell *sh, size_t argc, const char **argv) {
   ARG_UNUSED(sh);
   ARG_UNUSED(argc);
   ARG_UNUSED(argv);

   k_event_post(&client_events, ce_stop);
   return 0;
}

int dummy_help(const shell *sh, size_t argc, const char **argv) {
   if (argc == 1) {
      shell_help(sh);
      return 1;
   }

   shell_error(sh, "%s unknown command: %s", argv[0], argv[1]);
   return -EINVAL;
}

} // namespace

// ReSharper disable CppVariableCanBeMadeConstexpr
// NOLINTBEGIN(*-branch-clone)
SHELL_STATIC_SUBCMD_SET_CREATE(image_client_commands,
                               SHELL_CMD_ARG(fetch, NULL, "Fetch an image", shell_do_fetch, 1, 0),
                               SHELL_CMD_ARG(stop, NULL, "Stop the image client", shell_do_stop, 1, 0),
                               SHELL_SUBCMD_SET_END);
// NOLINTEND(*-branch-clone)
// ReSharper restore CppVariableCanBeMadeConstexpr

SHELL_SUBCMD_ADD((hei), image_client, &image_client_commands, "Image Client shell", dummy_help, 2, 0);

#endif // CONFIG_SHELL
```

## src/led.cpp
```c
/**
 * @file   led.cpp
 * @author Dennis Sitelew
 * @date   Oct. 20, 2024
 */

#include <hei/led.hpp>

#include <zephyr-cpp/drivers/gpio.hpp>

#include <zephyr/devicetree.h>
#include <zephyr/drivers/gpio.h>
#include <zephyr/init.h>
#include <zephyr/logging/log.h>

LOG_MODULE_REGISTER(led, CONFIG_APP_LOG_LEVEL);

using namespace zephyr;

namespace {

const gpio_dt_spec led_dt = GPIO_DT_SPEC_GET(DT_NODELABEL(led), gpios);

void_t try_init() {
   return gpio::ready(led_dt).and_then([&] {
      return gpio::configure(led_dt, GPIO_OUTPUT_INACTIVE);
   });
}

extern "C" {

int init_led(void) {
   auto init_res = try_init();
   if (!init_res) {
      return init_res.error().value();
   }
   return 0;
}

} // extern "C"

} // namespace

void_t hei::led::set_state(bool desired) {
   return gpio::set(led_dt, desired);
}

SYS_INIT(init_led, APPLICATION, CONFIG_APPLICATION_INIT_PRIORITY);
```

## src/server.cpp
```c
/**
 * @file   server.cpp
 * @author Dennis Sitelew
 * @date   Aug. 05, 2024
 */

#include <hei/server.hpp>

#include <zephyr/logging/log.h>
#include <zephyr/net/http/server.h>
#include <zephyr/net/http/service.h>

#include <array>
#include <cstdint>
#include <cstring>
#include <string_view>

LOG_MODULE_REGISTER(hei_http, CONFIG_APP_LOG_LEVEL);

namespace {

constexpr std::uint8_t index_html_gz[] = {
#include <hei/http/static/index.html.gz.inc>
};
constexpr std::size_t index_html_gz_size = sizeof(index_html_gz);

constexpr std::uint16_t http_server_port = 80;

std::uint8_t status_rx_buffer[1024];

class endpoint {
protected:
   static constexpr std::size_t target_buffer_size = 512;
   using array_t = std::array<std::uint8_t, target_buffer_size>;

public:
   auto &get_buffer() { return data_; }

   int handle_chunk(http_data_status status, http_method method, std::uint8_t *buffer, std::size_t length) {
      if (status == HTTP_SERVER_DATA_ABORTED) {
         LOG_DBG("Transaction aborted after %zd bytes.", size_);
         size_ = 0;
         return 0;
      }

      size_ += length;

      if (status == HTTP_SERVER_DATA_FINAL) {
         LOG_DBG("All data received (%zd bytes).", size_);

         auto result = handle_request(method);
         size_ = 0;
         return static_cast<int>(result);
      }

      return static_cast<int>(length);
   }

protected:
   virtual std::size_t handle_request(http_method method) = 0;

protected:
   array_t data_{};
   std::size_t size_{0};
};

class status_endpoint : public endpoint {
public:
   virtual std::size_t handle_request(http_method method) override {
      auto response = std::string_view{"{\"foo\": 42}"};
      using namespace std;
      copy(begin(response), end(response), begin(data_));
      return response.size();
   }
};

class available_networks_endpoint : public endpoint {
public:
   virtual std::size_t handle_request(http_method method) override {
      auto response = std::string_view{"{}"};
      using namespace std;
      copy(begin(response), end(response), begin(data_));
      return response.size();
   }
};

class update_config_endpoint : public endpoint {
public:
   virtual std::size_t handle_request(http_method method) override {
      auto response = std::string_view{"{}"};
      using namespace std;
      copy(begin(response), end(response), begin(data_));
      return response.size();
   }
};

status_endpoint status{};
available_networks_endpoint available_networks{};
update_config_endpoint update_config{};

struct named_endpoint {
   std::string_view path;
   endpoint *ep;
};

std::array endpoints = {
   named_endpoint{"/status", &status},
   named_endpoint{"/networks", &available_networks},
   named_endpoint{"/config", &update_config},
};

endpoint *endpoint_from_url(std::string_view path) {
   for (auto &ep : endpoints) {
      if (path.starts_with(ep.path)) {
         return ep.ep;
      }
   }
   return nullptr;
}

} // namespace

extern "C" {

HTTP_SERVICE_DEFINE(http_server_service, "0.0.0.0", &http_server_port, 1, 10, NULL);

struct http_resource_detail_static index_html_gz_resource_detail = {
   .common =
      {
         .bitmask_of_supported_http_methods = BIT(HTTP_GET),
         .type = HTTP_RESOURCE_TYPE_STATIC,
         .content_encoding = "gzip",
         .content_type = "text/html",
      },
   .static_data = index_html_gz,
   .static_data_len = index_html_gz_size,
};

HTTP_RESOURCE_DEFINE(index_html_gz_resource, http_server_service, "/", &index_html_gz_resource_detail);

static int dyn_handler(http_client_ctx *client,
                       http_data_status data_status,
                       std::uint8_t *buffer,
                       std::size_t len,
                       void *user_data) {
   ARG_UNUSED(user_data);

   auto path = reinterpret_cast<const char *>(client->url_buffer);
   LOG_DBG("Got request: %s", path);

   auto ep = endpoint_from_url(std::string_view{path});
   if (ep) {
      return ep->handle_chunk(data_status, client->method, buffer, len);
   }

   LOG_WRN("Unexpected endpoint: %s", path);
   return -404;
}

#define DYNAMIC_ENDPOINT(name, path, endpoint)                            \
   struct http_resource_detail_dynamic CONCAT(name, _resource_detail) = { \
      .common =                                                           \
         {                                                                \
            .bitmask_of_supported_http_methods = BIT(HTTP_POST),          \
            .type = HTTP_RESOURCE_TYPE_DYNAMIC,                           \
         },                                                               \
      .cb = dyn_handler,                                                  \
      .data_buffer = endpoint.get_buffer().data(),                        \
      .data_buffer_len = available_networks.get_buffer().size(),          \
      .user_data = nullptr,                                               \
   };                                                                     \
   HTTP_RESOURCE_DEFINE(CONCAT(name, _resource), http_server_service, path, &CONCAT(name, _resource_detail))

DYNAMIC_ENDPOINT(http_status, "/status", status);
DYNAMIC_ENDPOINT(http_networks, "/networks", available_networks);
DYNAMIC_ENDPOINT(http_config, "/config", update_config);

} // extern "C"

namespace hei::server {

void start() {
   http_server_start();
}

} // namespace hei::server
```

## src/shell.c
```c
/**
 * @file   shell.cpp
 * @author Dennis Sitelew
 * @date   Aug. 02, 2024
 */

#if CONFIG_SHELL
#include <zephyr/shell/shell.h>

SHELL_SUBCMD_SET_CREATE(hei_sub_cmd, (hei));
SHELL_CMD_REGISTER(hei, &hei_sub_cmd, "Hassio E-Ink commands", NULL);

#endif // CONFIG_SHELL
```

## src/shutdown.cpp
```c
/**
 * @file   shutdown.cpp
 * @author Dennis Sitelew
 * @date   Oct. 20, 2024
 */

#include <hei/shutdown.hpp>

#include <zephyr/drivers/uart.h>
#include <zephyr/init.h>
#include <zephyr/logging/log.h>

#include <zephyr/sys/crc.h>

#include <array>
#include <cstdint>
#include <utility>

LOG_MODULE_REGISTER(shutdown, CONFIG_APP_LOG_LEVEL);

namespace {

const device *uart_dev = DEVICE_DT_GET(DT_NODELABEL(uart2));

extern "C" {

int init_uart(void) {
   if (!device_is_ready(uart_dev)) {
      LOG_ERR("Shutdown UART not ready");
      return -ENODEV;
   }

   return 0;
}

} // extern "C"

} // namespace

void hei::shutdown::request(std::chrono::seconds duration) {
   const auto num_seconds = static_cast<std::uint16_t>(duration.count());

   LOG_INF("Shutting down for %d seconds", static_cast<int>(num_seconds));

   auto split = [](const std::uint16_t value) -> std::pair<std::uint8_t, std::uint8_t> {
      const auto low = static_cast<std::uint8_t>(value & 0xFF);
      const auto high = static_cast<std::uint8_t>((value >> 8) & 0xFF);
      return {low, high};
   };

   const auto seconds = split(num_seconds);
   std::array<std::uint8_t, 6> payload = {
      0xDE, 0xAD, seconds.first, seconds.second, 0xBE, 0xEF,
   };

   // 2 bytes magic number + 2 bytes duration = 4 bytes total length
   const auto crc_value = crc16_ansi(payload.data(), 4);
   const auto crc = split(crc_value);
   payload[4] = crc.first;
   payload[5] = crc.second;

   for (const auto byte : payload) {
      uart_poll_out(uart_dev, byte);
   }
}

SYS_INIT(init_uart, APPLICATION, CONFIG_APPLICATION_INIT_PRIORITY);
```
